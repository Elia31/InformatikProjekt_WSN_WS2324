## prj.conf
```kconfig
CONFIG_GPIO=y
# Enable OpenThread FTD features set 
CONFIG_OPENTHREAD_NORDIC_LIBRARY_FTD=y 
# L2 OpenThread enabling 
CONFIG_NET_L2_OPENTHREAD=y 
# Generic networking options 
CONFIG_NETWORKING=y

# Network parameter 
CONFIG_OPENTHREAD_MANUAL_START=n 
CONFIG_OPENTHREAD_NETWORK_NAME="WSN00" 
CONFIG_OPENTHREAD_PANID=10000  
CONFIG_OPENTHREAD_XPANID="fb:02:00:00:ab:cd:00:00" 
CONFIG_OPENTHREAD_NETWORKKEY="00:11:22:33:44:55:66:77:88:99:aa:bb:cc:dd:ee:ff"

#Additional parameter 
CONFIG_MBEDTLS_SHA1_C=n 
CONFIG_FPU=y 
CONFIG_GPIO=y
```

## src/main.c
```c
#include <zephyr/kernel.h>
#include <zephyr/drivers/gpio.h>
#include <zephyr/sys/printk.h>
#include <zephyr/net/openthread.h>
#include <openthread/thread.h>
#include <openthread/udp.h>

#define SLEEP_TIME_MS 1000

void udpReceiveCb(void *aContext, otMessage *aMessage, const otMessageInfo *aMessageInfo)
{
    uint16_t payloadLength = otMessageGetLength(aMessage) - otMessageGetOffset(aMessage);
    char buf[payloadLength + 1];
    otMessageRead(aMessage, otMessageGetOffset(aMessage), buf, payloadLength);
    buf[payloadLength] = '\0';
    printk("%s\n", buf);
}

static void udp_init(void)
{
    otError error = OT_ERROR_NONE;
    otInstance *myInstance = openthread_get_default_instance();
    otUdpSocket mySocket;
    otSockAddr mySockAddr;
    memset(&mySockAddr, 0, sizeof(mySockAddr));
    mySockAddr.mPort = 3101;

    do
    {
        error = otUdpOpen(myInstance, &mySocket, udpReceiveCb, NULL);
        if (error != OT_ERROR_NONE)
        {
            break;
        }

        error = otUdpBind(myInstance, &mySocket, &mySockAddr, OT_NETIF_THREAD);
    } while (false);

    if (error != OT_ERROR_NONE)
    {
        printk("init_udp error: %d\n", error);
    }
}

int main(void)
{
    udp_init();
    while (1)
    {
        k_msleep(SLEEP_TIME_MS);
    }
}
```
